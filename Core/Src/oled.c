#include "oled.h"
#include "gpio.h"
#include <string.h>

/* =========================================================================
   SSD1306 / SH1106 OLED driver -- software bit-banged I2C (PB6=SCL, PB7=SDA)

   - STM32F1 hardware I2C has a well-known BUSY lockup bug, so we bit-bang.
   - Interrupts stay enabled: only the display task uses this bus and a task
     switch only stretches SCL low, which I2C slaves tolerate. This keeps the
     USART1 receive ISR responsive during a full screen refresh.
   - Framebuffer in RAM; OLED_Refresh() pushes one page (128 bytes) per tx.
   ========================================================================= */

#define OLED_SCL_PORT   GPIOB
#define OLED_SCL_PIN    GPIO_PIN_6
#define OLED_SDA_PORT   GPIOB
#define OLED_SDA_PIN    GPIO_PIN_7

#define OLED_CTRL_CMD   0x00
#define OLED_CTRL_DATA  0x40

static uint8_t g_col_offset = 0;
static uint8_t g_oled_addr7 = 0x3C;
static uint8_t g_fb[128 * 8];

/* 16x16 display bitmaps for 信、宏、恩, stored page-major. */
static const uint8_t g_name_glyphs[3][32] =
{
    {0x00,0x00,0x00,0xFF,0x1E,0x1C,0x18,0xF0,0x00,0x00,0x00,0x00,0x00,0x00,0x00,0x00,
     0x01,0x01,0x01,0xFF,0x91,0x91,0x91,0x91,0x91,0x91,0x91,0x91,0x91,0x91,0xFF,0x00},
    {0x00,0x00,0x00,0x7C,0x46,0x46,0x47,0x47,0x47,0x47,0x46,0x46,0x7C,0x00,0x00,0x00,
     0x00,0x00,0xC0,0xA0,0x90,0x9F,0x95,0x95,0x95,0x95,0x9F,0x90,0xA0,0xC0,0x00,0x00},
    {0x00,0x7F,0x41,0x5D,0x5D,0x55,0x5D,0x55,0x55,0x5D,0x55,0x5D,0x5D,0x41,0x7F,0x00,
     0x00,0x40,0x60,0x70,0x78,0x7C,0x7E,0x7F,0x7E,0x7C,0x78,0x70,0x60,0x40,0x00,0x00}
};

#define SCL_H()  HAL_GPIO_WritePin(OLED_SCL_PORT, OLED_SCL_PIN, GPIO_PIN_SET)
#define SCL_L()  HAL_GPIO_WritePin(OLED_SCL_PORT, OLED_SCL_PIN, GPIO_PIN_RESET)
#define SDA_H()  HAL_GPIO_WritePin(OLED_SDA_PORT, OLED_SDA_PIN, GPIO_PIN_SET)
#define SDA_L()  HAL_GPIO_WritePin(OLED_SDA_PORT, OLED_SDA_PIN, GPIO_PIN_RESET)
#define SDA_RD() HAL_GPIO_ReadPin(OLED_SDA_PORT, OLED_SDA_PIN)
#define SCL_RD() HAL_GPIO_ReadPin(OLED_SCL_PORT, OLED_SCL_PIN)

static const uint8_t F6x8[][6] =
{
    {0x00,0x00,0x00,0x00,0x00,0x00},
    {0x00,0x00,0x00,0x2f,0x00,0x00},
    {0x00,0x00,0x07,0x00,0x07,0x00},
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    {0x00,0x44,0x64,0x54,0x4C,0x44},
};

static void I2C_Delay(void)
{
    /* Keep the timing stable while the OLED transaction is protected from
       the RTOS tick. This matches the known-good project configuration. */
    for (volatile uint32_t i = 0; i < 80; i++) { __NOP(); }
}

static void I2C_Start(void)
{
    SDA_H(); SCL_H(); I2C_Delay();
    SDA_L(); I2C_Delay();
    SCL_L(); I2C_Delay();
}

static void I2C_Stop(void)
{
    SDA_L(); I2C_Delay();
    SCL_H(); I2C_Delay();
    SDA_H(); I2C_Delay();
}

static uint8_t I2C_WriteByte(uint8_t b)
{
    uint8_t i, ack;
    for (i = 0; i < 8; i++)
    {
        if (b & 0x80) { SDA_H(); } else { SDA_L(); }
        b <<= 1;
        I2C_Delay();
        SCL_H(); I2C_Delay();
        SCL_L(); I2C_Delay();
    }
    SDA_H(); I2C_Delay();
    SCL_H(); I2C_Delay();
    ack = (SDA_RD() == GPIO_PIN_RESET) ? 0 : 1;
    SCL_L(); I2C_Delay();
    return ack;
}

static uint8_t I2C_Begin(uint8_t ctrl)
{
    I2C_Start();
    if (I2C_WriteByte((uint8_t)(g_oled_addr7 << 1)) != 0) { I2C_Stop(); return 1; }
    if (I2C_WriteByte(ctrl) != 0) { I2C_Stop(); return 1; }
    return 0;
}

static void OLED_Write_Cmd(uint8_t c)
{
    __disable_irq();
    if (I2C_Begin(OLED_CTRL_CMD) == 0) { I2C_WriteByte(c); }
    I2C_Stop();
    __enable_irq();
}

static void OLED_Set_Pos(uint8_t x, uint8_t y)
{
    x += g_col_offset;
    OLED_Write_Cmd(0xb0 + y);
    OLED_Write_Cmd(0x10 | ((x >> 4) & 0x0f));
    OLED_Write_Cmd(0x00 | (x & 0x0f));
}

uint8_t OLED_ScanAddress(void)
{
    static const uint8_t candidates[2] = { 0x3C, 0x3D };
    uint8_t k;
    for (k = 0; k < 2; k++)
    {
        __disable_irq();
        I2C_Start();
        if (I2C_WriteByte((uint8_t)(candidates[k] << 1)) == 0)
        {
            I2C_Stop();
            __enable_irq();
            return candidates[k];
        }
        I2C_Stop();
        __enable_irq();
    }
    return 0;
}

uint8_t OLED_GetAddress(void) { return g_oled_addr7; }

static void OLED_GPIO_Init(void)
{
    GPIO_InitTypeDef gi = {0};
    __HAL_RCC_GPIOB_CLK_ENABLE();
    gi.Pin = OLED_SCL_PIN | OLED_SDA_PIN;
    gi.Mode = GPIO_MODE_OUTPUT_OD;
    gi.Pull = GPIO_PULLUP;
    gi.Speed = GPIO_SPEED_FREQ_HIGH;
    HAL_GPIO_Init(GPIOB, &gi);
    SCL_H(); SDA_H();
}

void OLED_Clear(void) { memset(g_fb, 0, sizeof(g_fb)); }

void OLED_Refresh(void)
{
    uint8_t y, x;
    for (y = 0; y < 8; y++)
    {
        OLED_Set_Pos(0, y);
        __disable_irq();
        if (I2C_Begin(OLED_CTRL_DATA) == 0)
        {
            for (x = 0; x < 128; x++) { I2C_WriteByte(g_fb[y * 128 + x]); }
        }
        I2C_Stop();
        __enable_irq();
    }
}

static void fb_draw_char(uint8_t x, uint8_t y, char ch)
{
    const uint8_t *glyph;
    uint8_t i;
    if (y > 7) { return; }
    if (ch < ' ' || ch > 'z') { ch = ' '; }
    glyph = F6x8[(uint8_t)ch - ' '];
    for (i = 0; i < 6; i++)
    {
        if ((x + i) < 128) { g_fb[y * 128 + x + i] = glyph[i]; }
    }
}

void OLED_ShowString(uint8_t x, uint8_t y, uint8_t *str)
{
    while (*str != '\0') { fb_draw_char(x, y, (char)*str); x += 6; str++; }
}

void OLED_ShowChineseName(uint8_t x, uint8_t y)
{
    uint8_t c, page, col;
    if ((y > 6U) || (x > 95U)) { return; }
    for (c = 0U; c < 3U; c++)
    {
        for (page = 0U; page < 2U; page++)
        {
            for (col = 0U; col < 16U; col++)
            {
                g_fb[(y + page) * 128U + x + c * 16U + col] =
                    g_name_glyphs[c][page * 16U + col];
            }
        }
    }
}

void OLED_ShowNum(uint8_t x, uint8_t y, uint32_t num, uint8_t len, uint8_t size)
{
    uint8_t i, step = size / 2;
    uint32_t divisor = 1;
    char ch;
    for (i = 1; i < len; i++) { divisor *= 10; }
    for (i = 0; i < len; i++)
    {
        ch = (char)('0' + (num / divisor) % 10);
        fb_draw_char(x + step * i, y, ch);
        divisor /= 10;
    }
}

void OLED_Init(void)
{
    uint8_t addr;

    HAL_Delay(100);
    OLED_GPIO_Init();

    addr = OLED_ScanAddress();
    g_oled_addr7 = (addr != 0) ? addr : 0x3C;

    OLED_Write_Cmd(0xAE);
    OLED_Write_Cmd(0xD5); OLED_Write_Cmd(0x80);
    OLED_Write_Cmd(0xA8); OLED_Write_Cmd(0x3F);
    OLED_Write_Cmd(0xD3); OLED_Write_Cmd(0x00);
    OLED_Write_Cmd(0x40);
    OLED_Write_Cmd(0x8D); OLED_Write_Cmd(0x14);
    HAL_Delay(10);
    OLED_Write_Cmd(0x20); OLED_Write_Cmd(0x02);
    OLED_Write_Cmd(0xA1);
    OLED_Write_Cmd(0xC8);
    OLED_Write_Cmd(0xDA); OLED_Write_Cmd(0x12);
    OLED_Write_Cmd(0x81); OLED_Write_Cmd(0xCF);
    OLED_Write_Cmd(0xD9); OLED_Write_Cmd(0xF1);
    OLED_Write_Cmd(0xDB); OLED_Write_Cmd(0x30);
    OLED_Write_Cmd(0xA4);
    OLED_Write_Cmd(0xA6);
    OLED_Write_Cmd(0xAF);
    HAL_Delay(10);

    g_col_offset = 0;
    OLED_Clear();
    OLED_Refresh();
}
